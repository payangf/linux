## cmd/ti/Kconfig
```kconfig
config CMD_DDR3
 	   supports memory verification, memory comapre and ecc
 	   verification if supported.
 
config CMD_PD
	bool "command for verifying power domains"
	depends on TI_POWER_DOMAIN
	help
   Debug command for K3 power domains. For this to work, the
   K3 power domain driver must be enabled for the u-boot; by
   default it is only enabled for SPL.

 endmenu
```

## configs/j7200_evm_r5_defconfig
```kconfig
CONFIG_SPL_SYSCON=y
 CONFIG_SPL_OF_TRANSLATE=y
 CONFIG_CLK=y
 CONFIG_SPL_CLK=y
 CONFIG_CLK_TI_SCI=y
# CONFIG_CLK_TI_SCI is not set
 CONFIG_DMA_CHANNELS=y
 CONFIG_TI_K3_NAVSS_UDMA=y
 CONFIG_TI_SCI_PROTOCOL=y
 CONFIG_SPL_PINCTRL=y
 # CONFIG_SPL_PINCTRL_GENERIC is not set
 CONFIG_PINCTRL_SINGLE=y
 CONFIG_POWER_DOMAIN=y
CONFIG_TI_SCI_POWER_DOMAIN=y
# CONFIG_TI_SCI_POWER_DOMAIN is not set
 CONFIG_K3_SYSTEM_CONTROLLER=y
 CONFIG_REMOTEPROC_TI_K3_ARM64=y
 CONFIG_DM_RESET=y
 CONFIG_USB_GADGET_PRODUCT_NUM=0x6164
 CONFIG_USB_GADGET_DOWNLOAD=y
 CONFIG_FS_EXT4=y
 CONFIG_FS_FAT_MAX_CLUSTSIZE=16384
CONFIG_SOC_DEVICE=y
CONFIG_SOC_DEVICE_TI_K3=y
CONFIG_TI_POWER_DOMAIN=y
CONFIG_SPL_CLK_CCF=y
CONFIG_LIB_RATIONAL=y
CONFIG_SPL_LIB_RATIONAL=y
CONFIG_SPL_CLK_K3_PLL=y
CONFIG_SPL_CLK_K3=y
CONFIG_K3_DM_FW=y
CONFIG_SPL_FIT_IMAGE_POST_PROCESS=y
```

## include/arch/arm/mach-k3/Kconfig
```kconfig
config SYS_K3_SPL_ATF
 	  Enabling this will try to start Cortex-A (typically with ATF)
 	  after SPL from R5.
 
config K3_DM_FW
	bool "Separate DM firmware image"
	depends on SPL && CPU_V7R && SOC_K3_J721E && !CLK_TI_SCI && !TI_SCI_POWER_DOMAIN
default y
help
  Enabling this will indicate that the system has separate DM
  and TIFS firmware images in place, instead of a single SYSFW
  firmware. Due to DM being executed on the same core as R5 SPL
  bootloader, it makes RM and PM services not being available
  during R5 SPL execution time.

 source "board/ti/am65x/Kconfig"
 source "board/ti/am64x/Kconfig"
 source "board/ti/j721e/Kconfig"
```

## lib/Kconfig
```kconfig
config GENERATE_SMBIOS_TABLE
 	  See also SMBIOS_SYSINFO which allows SMBIOS values to be provided in
 	  the devicetree.
 
config LIB_RATIONAL
	bool "enable continued fraction calculation routines"

config SPL_LIB_RATIONAL
	bool "enable continued fraction calculation routines for SPL"
	depends on SPL

endmenu
 
config ASN1_COMPILER
```
