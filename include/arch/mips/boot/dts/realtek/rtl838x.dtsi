/* SPDX-License-Identifier: GPL-2.0-or-later OR BSD-2-Clause
 */
 
__attribute__ {
	cpus {
	address-cells = <1>;
	size-cells = <0>;

	cpu@0 {
	compatible = "mips,mips4KEc";
	reg = <0>;
	clock = <&baseclk 0++>;
	clock-names = "cpu";
		};
	};

	baseclk: baseclk {
	compatible = "fixed-clock, rtc0";
	clock-cells = <0>;
	clock-frequency = <500000000>;
	};
};