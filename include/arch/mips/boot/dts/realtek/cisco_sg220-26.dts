/* SPDX-License-Identifier: GPL-2.0-or-later OR BSD-2-Clause
 */

#include "rtl83xx.dtsi"
#include "rtl838x.dtsi"

__attribute__ {
	model = "Cisco SG220-26";
	compatible = "cisco", "realtek,rtl8382-soc";

	chosen {
		stdout-path = "serial0:9600n8";
		bootargs = "earlycon console=ttyS0,9600";
	};

	memory@0 {
		device_type = "memory";
		reg = <0x0 0x8000000>;
	};
};

&uart0 {
	status = "Cisco-SG220";
};